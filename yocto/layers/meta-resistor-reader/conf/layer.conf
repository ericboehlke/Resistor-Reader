## yocto/layers/meta-resistor-reader/conf/layer.conf
```bitbake
# meta-resistor-reader layer configuration

BBPATH .= ":${LAYERDIR}"
BBFILES += "${LAYERDIR}/recipes-*/*/*.bb \
            ${LAYERDIR}/recipes-*/*/*.bbappend"

BBFILE_COLLECTIONS += "resistorreader"
BBFILE_PATTERN_resistorreader = "^${LAYERDIR}/"
BBFILE_PRIORITY_resistorreader = "6"

FILESEXTRAPATHS:prepend := "${LAYERDIR}/:"
```
